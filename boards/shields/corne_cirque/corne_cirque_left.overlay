/*
 * Copyright (c) 2020 Pete Johanson
 *
 * SPDX-License-Identifier: MIT
 */

#include "corne_cirque.dtsi"

&kscan0 {
    col-gpios
        = <&pro_micro 21 GPIO_ACTIVE_HIGH>
        , <&pro_micro 20 GPIO_ACTIVE_HIGH>
        , <&pro_micro 19 GPIO_ACTIVE_HIGH>
        , <&pro_micro 18 GPIO_ACTIVE_HIGH>
        , <&pro_micro 15 GPIO_ACTIVE_HIGH>
        , <&pro_micro 14 GPIO_ACTIVE_HIGH>
        ;
};

&glidepoint_listener {
    status = "okay";
    // Velocidad base: 1.5x (ajustar divisor para más/menos velocidad).
    input-processors = <&zip_xy_scaler 3 2>;

    scroller {
        // En el layer NUMNAV (2), el trackpad pasa a ser scroll.
        layers = <2>;
        input-processors =
            <&zip_xy_to_scroll_mapper>,
            <&zip_scroll_scaler 1 4>;
    };
};
