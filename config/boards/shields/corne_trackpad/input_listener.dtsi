/*
 * Copyright (c) 2020 The ZMK Contributors
 *
 * SPDX-License-Identifier: MIT
 */

#include <dt-bindings/zmk/mouse.h>

/ {
    /* Input config for mouse scroll */
    ib_wheel_scaler: ib_wheel_scaler {
        compatible = "zmk,input-processor-scaler";
        #input-processor-cells = <0>;
        type = <INPUT_EV_REL>;
        codes = <INPUT_REL_X>, <INPUT_REL_Y>;
        track-remainders;
        scale-multiplier = <1>;
        scale-divisor = <1>;
    };

    /* Input listeners */
    ib_listener: ib_listener {
        compatible = "zmk,input-listener";
        device = <&ib_wheel_scaler>;
    };
};
