## config/boards/shields/corne_trackpad/Kconfig.defconfig
```kconfig
# Copyright (c) 2020 The ZMK Contributors
# SPDX-License-Identifier: MIT

if SHIELD_CORNE_TRACKPAD_RIGHT

config ZMK_KEYBOARD_NAME
    default "Corne Trackpad"

config ZMK_SPLIT_ROLE_CENTRAL
    default y

config ZMK_USB
    default y

endif # SHIELD_CORNE_TRACKPAD_RIGHT

if SHIELD_CORNE_TRACKPAD_LEFT || SHIELD_CORNE_TRACKPAD_RIGHT

config ZMK_SPLIT
    default y

if ZMK_MOUSE

config I2C
    default y

endif # ZMK_MOUSE

if ZMK_DISPLAY

config I2C
    default y

config SPI
    default y

endif # ZMK_DISPLAY

endif # SHIELD_CORNE_TRACKPAD_LEFT || SHIELD_CORNE_TRACKPAD_RIGHT
```

## config/boards/shields/corne_trackpad/Kconfig.shield
```kconfig
# Copyright (c) 2020 The ZMK Contributors
# SPDX-License-Identifier: MIT

config SHIELD_CORNE_TRACKPAD_LEFT
    def_bool $(shields_list_contains,corne_trackpad_left)

config SHIELD_CORNE_TRACKPAD_RIGHT
    def_bool $(shields_list_contains,corne_trackpad_right)
```
